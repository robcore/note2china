## arch/arm/configs/jf_sglte_defconfig
```kconfig
CONFIG_MACH_JF_EUR=y
CONFIG_MACH_JF_SGLTE=y
CONFIG_EXTRA_FIRMWARE="audience-es325-fw-eur.bin"
CONFIG_EXTRA_FIRMWARE_DIR="firmware"
CONFIG_RTC_AUTO_PWRON=y
CONFIG_CHARGER_MAX77803=y
CONFIG_TARGET_LOCALE_CHN=y
CONFIG_WLAN_REGION_CODE=300
CONFIG_TOUCHSCREEN_SYNAPTICS_I2C_RMI=n
CONFIG_TOUCHSCREEN_ATMEL_MXTS=n
CONFIG_TOUCHSCREEN_MELFAS_NOTE=y
CONFIG_SND_SOC_ES325=y
CONFIG_SND_SOC_ES325_SLIM=y
CONFIG_BCM2079X_NFC_I2C=n
CONFIG_SENSORS_SSP_CM3320=n
CONFIG_SENSORS_SSP_MAX88920=n
CONFIG_SENSORS_SSP_SHTC1=n
CONFIG_SENSORS_SSP_CM36651=y
CONFIG_SENSORS_T0_SGLTE=y
CONFIG_FB_MSM_MIPI_SAMSUNG_OCTA_VIDEO_FULL_HD_PT_PANEL=n
CONFIG_FB_MSM_MIPI_SAMSUNG_OLED_VIDEO_HD_PT_PANEL=y
CONFIG_MDNIE_LITE_TUNING=n
CONFIG_FB_MDP4_ENHANCE=y
CONFIG_INPUT_WACOM=y
CONFIG_EPEN_WACOM_G9PM=y

CONFIG_SENSORS_HALL=n

# camera
CONFIG_S5K3H5XA=y
CONFIG_S5K6A3YX=y
CONFIG_CAMERA_USE_GSBI7=y
CONFIG_IMX175_EEPROM=y
CONFIG_CAMERA_SW_I2C_ACT=y
CONFIG_CAMERA_SW_I2C=n

CONFIG_BCM2079X_NFC_I2C=n
#QSC MODEM DOWNLAOD
CONFIG_SGLTE_QSC_MODEM=y
```

## note2china/arch/arm/configs/jf_cmcc_defconfig
```kconfig
CONFIG_MACH_JF_EUR=y
CONFIG_EXTRA_FIRMWARE="audience-es325-fw-eur.bin"
CONFIG_EXTRA_FIRMWARE_DIR="firmware"
CONFIG_RTC_AUTO_PWRON=y
CONFIG_TARGET_LOCALE_CHN=y
CONFIG_WLAN_REGION_CODE=300
```

## note2china/arch/arm/configs/jf_eur_defconfig
```kconfig
CONFIG_MACH_JF_EUR=y
CONFIG_EXTRA_FIRMWARE="audience-es325-fw-eur.bin"
CONFIG_EXTRA_FIRMWARE_DIR="firmware"
CONFIG_FB_MSM_MIPI_SAMSUNG_OCTA_VIDEO_FULL_HD_PT_PANEL=n
CONFIG_FB_MSM_MIPI_SAMSUNG_OLED_VIDEO_HD_PT_PANEL=y
CONFIG_TOUCHSCREEN_SYNAPTICS_I2C_RMI=n
CONFIG_TOUCHSCREEN_ATMEL_MXTS=n
CONFIG_TOUCHSCREEN_MELFAS_NOTE=y
```
